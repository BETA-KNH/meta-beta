/dts-v1/;
/plugin/;

/ {
	compatible = "brcm,bcm2835";

	fragment@0 {
		target-path = "/axi/pcie@120000/rp1/i2c@88000/ts@38";
		__overlay__ {
			polling-mode;
			/delete-property/ interrupts;
			/delete-property/ interrupt-parent;
			/delete-property/ interrupt-gpios;
			touchscreen-size-x = <800>;
			touchscreen-size-y = <480>;
		};
	};
};
