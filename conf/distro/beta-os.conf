## conf/distro/beta-os.conf
```bitbake
DISTRO_NAME = "beta-os"
DISTRO_VERSION = "pre-release"

DISTRO_DESCRIPTION = "Operating System for Humanoid Robot project"
DISTRO_CODENAME = "beta-os"

# Set system hostname via base-files recipe
hostname:pn-base-files = "beta-robot"

# Set default timezone to Poland
DEFAULT_TIMEZONE = "Europe/Warsaw"

# ROS 2 distribution selection (meta-ros)
ROS_DISTRO = "jazzy"

LICENSE_FLAGS_ACCEPTED = "synaptics-killswitch"

# Use systemd as init manager (required for RAUC)
INIT_MANAGER = "systemd"

DISTRO_FEATURES:append = " \
        rauc \
        systemd \
        opengl \
        wayland \
        pam \
        wifi \
        ros \
        polkit \
"

# Raspberry Pi specific settings for RAUC (from meta-rauc-raspberrypi README)
ENABLE_UART = "1"
RPI_USE_U_BOOT = "1"
ENABLE_I2C = "1"
KERNEL_MODULE_AUTOLOAD:append = " i2c-dev"

# Image format settings for RAUC
IMAGE_FSTYPES:append = " ext4 wic wic.bz2"
WKS_FILE = "sdimage-dual-raspberrypi.wks.in"

PREFERRED_PROVIDER_virtual/egl ?= "mesa"
PREFERRED_PROVIDER_virtual/libgles2 ?= "mesa"
PREFERRED_PROVIDER_virtual/libgl ?= "mesa"
PREFERRED_PROVIDER_virtual/mesa ?= "mesa"

# Package management - use IPK/opkg
# This avoids having to set PACKAGE_CLASSES in local.conf
PACKAGE_CLASSES = "package_ipk"

# Deploy custom FT5406 touch overlay into Raspberry Pi boot partition
EXTRA_IMAGEDEPENDS:append = " rpi-ft5406-polling-overlay rpi-pi5-i2c-overlays"
IMAGE_BOOT_FILES:append = " ft5406-polling.dtbo;overlays/ft5406-polling.dtbo i2c2-pi5.dtbo;overlays/i2c2-pi5.dtbo i2c3-pi5.dtbo;overlays/i2c3-pi5.dtbo"
```

## conf/layer.conf
```bitbake
BBPATH .= ":${LAYERDIR}"

BBFILES += "${LAYERDIR}/recipes-*/*/*.bb \
            ${LAYERDIR}/recipes-*/*/*.bbappend"

BBFILE_COLLECTIONS += "meta-beta"
BBFILE_PATTERN_meta-beta = "^${LAYERDIR}/"
BBFILE_PRIORITY_meta-beta = "15"

LAYERDEPENDS_meta-beta = "core"
LAYERSERIES_COMPAT_meta-beta = "scarthgap"
```
